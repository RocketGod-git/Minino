## firmware/components/open_thread/Kconfig.projbuild
```kconfig
menu "OpenThread Configuration"
	config OPTHREAD_CHANNEL
		int "OpenThread channel"
		range 11 26
		default 15
		help
			Select the OpenThread channel.
	config OPTHREAD_PANID
		string "OpenThread PANID"
		default "0x1234"
		help
			Network PANID.
	config OPTHREAD_NETWORK_NAME
		string "OpenThread network name"
		default "Minino-OPThread"
		help
			Network name.
	config OPTHREAD_EXTPANID
		string "OpenThread  network extpanid"
		default "dead00beef00cafe"
		help
			Network extpanid.

	config OPTHREAD_MESH_LOCAL_PREFIX
		string "OpenThread local prefix"
		default "fd00:db8:a0:0::/64"
		help
			Network local prefix.

	config OPTHREAD_NETWORK_MASTERKEY
		string "OpenThread network masterkey"
		default "00112233445566778899aabbccddeeff"
		help
			Network master key.
	
	config OPTHREAD_NETWORK_PSKC
		string "OpenThread network pskc"
		default "104810e2315100afd6bc9215a6bfac53"
		help
			Network preshare key.
endmenu
```
